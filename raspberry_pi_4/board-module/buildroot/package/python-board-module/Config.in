## raspberry_pi_4/board-module/buildroot/package/python-board-module/Config.in
```kconfig
config BR2_PACKAGE_PYTHON_BOARD_MODULE
	bool "python_board_module"
	depends on BR2_PACKAGE_PYTHON3
	depends on BR2_PACKAGE_PYTHON_SERIAL
	help
	  Python version of Board module targeting system
```

## raspberry_pi_4/board-module/buildroot/package/python-linuxpy/Config.in
```kconfig
config BR2_PACKAGE_PYTHON_LINUXPY
    bool "python-linuxpy"
    depends on BR2_PACKAGE_PYTHON3
    depends on BR2_PACKAGE_PYTHON_PIP
    help
      linuxpy — Python bindings for Linux input devices.
      https://github.com/tiagocoutinho/linuxpy
```

## raspberry_pi_4/board-module/buildroot/package/yamspy/Config.in
```kconfig
config BR2_PACKAGE_YAMSPY
    bool "yamspy"
    depends on BR2_PACKAGE_PYTHON3
    depends on BR2_PACKAGE_PYTHON_SERIAL
    help
      YAMSPy is a MSP provider for FC (Betaflight, iNAV, etc.) telemetry
```

## raspberry_pi_4/handset-module/buildroot/package/python-handset-module/Config.in
```kconfig
config BR2_PACKAGE_PYTHON_HANDSET_MODULE
	bool "python_handset_module"
	depends on BR2_PACKAGE_PYTHON3
	depends on BR2_PACKAGE_PYTHON_SERIAL
	help
	  Python version of Handset module targeting system
```
